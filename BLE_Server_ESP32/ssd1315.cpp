#include <Adafruit_GFX.h>
#include <Adafruit_SSD1306.h>
#include <Wire.h>

#include "ssd1315.h"

int8_t icons[NUMICONS][3] = { 0 };
const unsigned char* bitmaps[NUMICONS];
const unsigned char PROGMEM ble_paired_bmp[] = { 0x00, 0x00, 0x00, 0x00, 0x00, 0x00, 0x00, 0x00, 0x00, 0x00, 0x00, 0x00, 0x00,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 0x00, 0x68 };
const unsigned char PROGMEM temperature_bmp[] = { 0x1c, 0x00, 0x22, 0x02, 0x2b, 0x05, 0x2a, 0x02, 0x2b, 0x38, 0x2a, 0x60, 0x2b, 0x40, 0x2a, 0x40, 0x2a, 0x60, 0x49, 0x38, 0x9c, 0x80, 0xae, 0x80, 0xbe, 0x80, 0x9c, 0x80, 0x41, 0x00, 0x3e, 0x00 };
const unsigned char android_bmp[] PROGMEM = {
  0x00, 0x00, 0x00, 0x00, 0x00, 0x00, 0x00, 0x00, 0x00, 0x00, 0x00, 0x00, 0x40, 0x02, 0x20, 0x04,
  0x10, 0x08, 0x1f, 0xf8, 0x3f, 0xfc, 0x7f, 0xfe, 0xe7, 0xe7, 0xff, 0xff, 0xff, 0xff, 0xff, 0xff
};
const unsigned char firebase_bmp[] PROGMEM = {
  0x00, 0x80, 0x01, 0xc0, 0x03, 0x60, 0x02, 0x30, 0x04, 0x10, 0x04, 0x08, 0x3e, 0x0c, 0x27, 0x04,
  0x24, 0x86, 0x24, 0x82, 0x22, 0x82, 0x22, 0x82, 0x31, 0x8c, 0x19, 0x98, 0x0f, 0x70, 0x03, 0xc0
};
const unsigned char kotlin_bmp[] PROGMEM = {
  0xfe, 0xff, 0xfd, 0xfe, 0xfb, 0xfc, 0xf7, 0xf8, 0xef, 0xf0, 0xdf, 0xe0, 0xbf, 0xc0, 0x7f, 0x80,
  0xff, 0x00, 0xfe, 0xc0, 0xfd, 0xe0, 0xfb, 0xf0, 0xf7, 0xf8, 0xef, 0xfc, 0xdf, 0xfe, 0xbf, 0xff
};
const unsigned char mysql_bmp[] PROGMEM = {
  0x60, 0x00, 0x90, 0x00, 0x9e, 0x00, 0x43, 0x00, 0x4d, 0x80, 0x64, 0xc0, 0x20, 0x40, 0x20, 0x60,
  0x20, 0x20, 0x30, 0x20, 0x20, 0x1e, 0x28, 0x01, 0x48, 0x07, 0x54, 0x04, 0x24, 0x08, 0x02, 0x06
};
const unsigned char python_bmp[] PROGMEM = {
  0x07, 0xe0, 0x0d, 0xf0, 0x0f, 0xf0, 0x01, 0xf4, 0x3f, 0xf6, 0x7f, 0xf6, 0xff, 0xef, 0xff, 0xcf,
  0xf0, 0x3f, 0xf7, 0xff, 0x6f, 0xfe, 0x2f, 0xfc, 0x0f, 0x80, 0x0f, 0xf0, 0x0f, 0xd0, 0x07, 0xe0
};
const unsigned char spring_bmp[] PROGMEM = {
  0x0f, 0xf8, 0x3f, 0xfc, 0x7f, 0xfd, 0x7f, 0xfd, 0xff, 0xf1, 0xff, 0xe1, 0xf8, 0x01, 0xf0, 0x01,
  0xe0, 0x09, 0xe0, 0x11, 0xe0, 0x61, 0xe0, 0xc3, 0xf3, 0x87, 0x7e, 0x1e, 0x37, 0xfc, 0x1f, 0xf8
};
const unsigned char nodejs_bmp[] PROGMEM = {
  0x07, 0x80, 0x1c, 0x60, 0x30, 0x30, 0x60, 0x18, 0x80, 0x04, 0x89, 0xe4, 0x8a, 0x34, 0x8b, 0x04,
  0x88, 0xe4, 0x8a, 0x14, 0x8b, 0x34, 0x89, 0xe4, 0x48, 0x0c, 0x30, 0x30, 0x00, 0xe0, 0x07, 0x80
};
const unsigned char js_bmp[] PROGMEM = {
  0xff, 0xff, 0xff, 0xff, 0xff, 0xff, 0xff, 0xff, 0xff, 0xff, 0xff, 0xff, 0xff, 0xff, 0xfe, 0x63,
  0xfe, 0x41, 0xfe, 0x4f, 0xfe, 0x47, 0xfe, 0x71, 0xfe, 0x79, 0xf2, 0x41, 0xf8, 0xe3, 0xff, 0xff
};
const unsigned char react_bmp[] PROGMEM = {
  0x00, 0x00, 0x0c, 0x30, 0x1b, 0x48, 0x11, 0x88, 0x13, 0x48, 0x0f, 0xf8, 0x3a, 0x2e, 0x45, 0xb9,
  0x45, 0xb1, 0x6c, 0x36, 0x1a, 0xe8, 0x0f, 0x78, 0x11, 0x88, 0x19, 0x48, 0x0e, 0x30, 0x00, 0x00
};
const unsigned char java_bmp[] PROGMEM = {
  0x01, 0x00, 0x00, 0x80, 0x01, 0x80, 0x03, 0x00, 0x07, 0x20, 0x0c, 0x60, 0x09, 0xc0, 0x1b, 0x80,
  0x1b, 0x00, 0x17, 0x00, 0x06, 0x0e, 0xff, 0xf3, 0x80, 0x03, 0x7f, 0xe2, 0x00, 0x4e, 0x1f, 0x80
};
const unsigned char docker_bmp[] PROGMEM = {
  0x00, 0x30, 0x00, 0x30, 0x00, 0x00, 0x0d, 0xb0, 0x0d, 0xb0, 0x00, 0x00, 0x6d, 0xb4, 0x6d, 0xb5,
  0x00, 0x06, 0xff, 0xfc, 0xff, 0xf8, 0xff, 0xf8, 0xff, 0xf0, 0x7f, 0xf0, 0x3f, 0xc0, 0x00, 0x00
};

const unsigned char* getRandomBitmap() {
  const unsigned char* bitmaps[] = { firebase_bmp, android_bmp, spring_bmp, kotlin_bmp, mysql_bmp, python_bmp, nodejs_bmp, js_bmp, react_bmp, java_bmp, docker_bmp };
  return bitmaps[random(11)];
}

bool isOverlapping(int x1, int y1, int x2, int y2, int width, int height) {
  if (x1 + width + 1 <= x2 || x2 + width + 1 <= x1 || y1 + height + 1 <= y2 || y2 + height + 1 <= y1)
    return false;
  return true;
}


void findNonOverlappingPosition(int f, int8_t& x, int8_t& y, int width, int height, int displayWidth, int displayHeight) {
  bool overlap;
  do {
    x = random(0, displayWidth - width);
    y = YOFFSET + random(0, LOGO_HEIGHT);
    overlap = false;
    for (int i = 0; i < NUMICONS; i++) {
      if (i == f) continue;
      if (isOverlapping(x, y, icons[i][XPOS], icons[i][YPOS], width, height)) {
        overlap = true;
        break;
      }
    }
  } while (overlap);
}

void initSsd1315(Adafruit_SSD1306* display) {
  // Display setup
  if (!display->begin(SSD1306_SWITCHCAPVCC, 0x3C)) {
    Serial.println(F("SSD1306 allocation failed"));
    for (;;)
      ;
  }
  delay(2000);
  display->clearDisplay();
  // Initialize 'icon' positions
  int8_t pos = 0;
  for (int f = 0; f < NUMICONS; f++) {
    icons[f][XPOS] = pos;
    pos += LOGO_WIDTH + random(1, 4);
    icons[f][YPOS] = YOFFSET + random(0, LOGO_HEIGHT);
    icons[f][DELTAY] = random(1, 5);
    bitmaps[f] = getRandomBitmap();
  }
}

void updateTempStatus(Adafruit_SSD1306* display, float temp) {
  // Assume that display is cleared
  display->drawBitmap(0, 0, temperature_bmp, LOGO_WIDTH, LOGO_HEIGHT, 1);
  display->setTextColor(1);
  display->setTextSize(2);
  display->setCursor(18, 1);
  display->print(temp, 1);
  // Assume that display method is called after this function
}

void updateAnimation(Adafruit_SSD1306* display) {
  // Draw each snowflake:
  for (int f = 0; f < NUMICONS; f++) {
    display->drawBitmap(icons[f][XPOS], icons[f][YPOS], bitmaps[f], LOGO_WIDTH, LOGO_HEIGHT, SSD1306_WHITE);
  }
  // Then update coordinates of each icon...
  for (int f = 0; f < NUMICONS; f++) {
    icons[f][YPOS] += icons[f][DELTAY];
    // If icon is off the bottom of the screen...
    if (icons[f][YPOS] >= display->height()) {
      // Reinitialize to a random position, just off the top
      findNonOverlappingPosition(f, icons[f][XPOS], icons[f][YPOS], LOGO_WIDTH, LOGO_HEIGHT, display->width(), display->height());
      icons[f][DELTAY] = random(1, 5);
      bitmaps[f] = getRandomBitmap();
    }
  }
}

void drawBlePairedStatus(Adafruit_SSD1306* display) {
  display->drawBitmap(0, 0, ble_paired_bmp, display->width(), display->height(), 1);
}
